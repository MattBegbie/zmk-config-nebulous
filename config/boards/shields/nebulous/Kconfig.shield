## config/boards/shields/nebulous/Kconfig.shield
```kconfig
config SHIELD_NEBULOUS_LEFT
    def_bool $(shields_list_contains,nebulous_left)

config SHIELD_NEBULOUS_RIGHT
    def_bool $(shields_list_contains,nebulous_right)
```
